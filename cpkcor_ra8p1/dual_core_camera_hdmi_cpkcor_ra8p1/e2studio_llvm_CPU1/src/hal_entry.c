#include <stdio.h>

#include "console.h"
#include "hal_data.h"
#include "iic.h"
#include "sdram.h"

#include "camera/camera.h"
#include "lcd/lcd.h"
#include "perf_counter/perf_counter.h"
#include "SEGGER_RTT/SEGGER_RTT.h"
#include "test/test.h"
#include "utils/log.h"

#include "arm_2d.h"
#include "arm_2d_disp_adapter_0.h"
#include "arm2d/examples/common/benchmark/arm_2d_benchmark.h"

#define EN_ARM2D_BENCHMARK	0
#define EN_SDRAM_TEST		0

#define COVERT_CACHE_SIZE	(__DISP0_CFG_PFB_BLOCK_WIDTH__ * __DISP0_CFG_PFB_BLOCK_HEIGHT__ * sizeof(COLOUR_INT))

#define REPORT_ERROR(t, v, msg, ...)	if ((t != v) && (msg != NULL)) { printf(msg, ##__VA_ARGS__); }

extern const vin_extended_cfg_t g_vin_ov5640_cfg_extend;

#if (1 == BSP_MULTICORE_PROJECT) && BSP_TZ_SECURE_BUILD
bsp_ipc_semaphore_handle_t g_core_start_semaphore =
{
    .semaphore_num = 0
};
#endif

static Camera s_camera_ov5640_mipi;
static LCD_DeviceType s_lcd_tfp410;

static uint32_t tfp410IicRead(uint8_t *data_w, uint8_t len_w, uint8_t *data_r, uint8_t len_r);
static uint32_t tfp410IicWrite(uint8_t *data, uint8_t len);
static void updateCameraToLCD(void);

/*******************************************************************************************************************//**
 * main() is generated by the RA Configuration editor and is used to generate threads if an RTOS is used.  This function
 * is called by main() when no RTOS is used.
 **********************************************************************************************************************/
void hal_entry(void)
{
	/* TODO: add your own code here */
	uint32_t err;
	LCD_ConfigType tfp410_cfg;
	CameraConfig ov5640_config_mipi;

	perfc_init(false);
	R_IPC_Open(g_ipc0.p_ctrl, g_ipc0.p_cfg);
	R_IPC_Open(g_ipc1.p_ctrl, g_ipc1.p_cfg);
	IIC_Init();
#if EN_SDRAM_TEST
	puts("Before LCD and camera start, run SDRAM test");
	TestSDRAM(SDRAM_MAP_START_ADDR, SDRAM_SIZE, true, true);
	printf("\r\n\r\n");
#endif

	tfp410_cfg.model = LCD_MODEL_TFP410PAPR;
    tfp410_cfg.peri_1 = &g_lcdc_tfp410;
    tfp410_cfg.peri_model_1 = LCD_PERI_GLCDC;
    tfp410_cfg.peri_2 = NULL;
    tfp410_cfg.peri_model_2 = LCD_PERI_UNUSED;
    tfp410_cfg.iicWrite = tfp410IicWrite;
    tfp410_cfg.iicRead = tfp410IicRead;
    err = LCD_Initialize(&s_lcd_tfp410, &tfp410_cfg);
    REPORT_ERROR(err, 0, "LCD_Initialize() failed: %u", err);
    TestLCD(&s_lcd_tfp410);

    ov5640_config_mipi.model = CAMERA_MODEL_OV5640;
    ov5640_config_mipi.interface = CAMERA_INTERFACE_MIPI_CSI;
    ov5640_config_mipi.length = g_vin_ov5640_cfg_extend.conversion_data.uds_clipping_bits.cl_hsize;
    ov5640_config_mipi.width = g_vin_ov5640_cfg_extend.conversion_data.uds_clipping_bits.cl_vsize;
    ov5640_config_mipi.peripheral_inst = &g_vin_ov5640;
    err = CameraInit(&s_camera_ov5640_mipi, &ov5640_config_mipi);
    REPORT_ERROR(err, 0, "OV5640 MIPI interface init failed: %u", err);
    err = CameraSetFPS(&s_camera_ov5640_mipi, 30, NULL, false);
    REPORT_ERROR(err, 0, "OV5640 MIPI interface set FPS failed: %u", err);
    err = CameraStartCapture(&s_camera_ov5640_mipi, NULL);
    REPORT_ERROR(err, 0, "OV5640 MIPI interface start capture failed: %u", err);

    arm_2d_init();
    disp_adapter0_init();
    CONSOLE_Init();
    arm_2d_scene_player_set_switching_mode(&DISP0_ADAPTER, ARM_2D_SCENE_SWITCH_MODE_FADE_WHITE);
	arm_2d_scene_player_switch_to_next_scene(&DISP0_ADAPTER);

	printf("FSP Version: %s\r\n", FSP_VERSION_STRING);
	puts("CPU0 stdout stream already redirect to CPU1.");
	puts("CPU0 control USER key.");
	puts("You can press key and CPU0 will use printf() to output message.");
	puts("Then CPU1 show it in screen.");

	/* Wake up 2nd core if this is first core and we are inside a multicore project. */
#if (0 == _RA_CORE) && (1 == BSP_MULTICORE_PROJECT) && !BSP_TZ_NONSECURE_BUILD

#if BSP_TZ_SECURE_BUILD
    /* Take semaphore so 2nd core can clear it */
    R_BSP_IpcSemaphoreTake(&g_core_start_semaphore);
#endif

    R_BSP_SecondaryCoreStart();

#if BSP_TZ_SECURE_BUILD
    /* Wait for 2nd core to start and clear semaphore */
    while(FSP_ERR_IN_USE == R_BSP_IpcSemaphoreTake(&g_core_start_semaphore))
    {
        ;
    }
#endif
#endif

#if (1 == _RA_CORE) && (1 == BSP_MULTICORE_PROJECT) && BSP_TZ_SECURE_BUILD
    /* Signal to 1st core that 2nd core has started */
    R_BSP_IpcSemaphoreGive(&g_core_start_semaphore);
#endif

#if EN_ARM2D_BENCHMARK
    arm_2d_run_benchmark(&DISP0_ADAPTER);
#endif

    while (1) {
    	CONSOLE_Task();
    	disp_adapter0_task();
    	updateCameraToLCD();
    }

#if BSP_TZ_SECURE_BUILD
    /* Enter non-secure code */
    R_BSP_NonSecureEnter();
#endif
}

void GLCDC_Callback(display_callback_args_t *p_args)
{
	(void)p_args;
}

void IPC1_Callback(ipc_callback_args_t *p_args)
{
	if (p_args->event & IPC_EVENT_IRQ0) {
		CONSOLE_IPCIrqHandle();
	}
	if (p_args->event & IPC_EVENT_MESSAGE_RECEIVED) {
		CONSOLE_IPCMsgHandle(p_args->message);
	}
}

void MIPI_CSI_Callback(mipi_csi_callback_args_t *p_args)
{
	(void)p_args;
}

void VIN_Callback(capture_callback_args_t *p_args)
{
	(void)p_args;
}

#if BSP_TZ_SECURE_BUILD

FSP_CPP_HEADER
BSP_CMSE_NONSECURE_ENTRY void template_nonsecure_callable ();

/* Trustzone Secure Projects require at least one nonsecure callable function in order to build (Remove this if it is not required to build). */
BSP_CMSE_NONSECURE_ENTRY void template_nonsecure_callable ()
{

}
FSP_CPP_FOOTER

#endif

#if LOG_CFG_EN_TIMESTAMP
void LOG_GetTime(uint32_t *s, uint32_t *ms)
{
	int64_t t = get_system_ms();
	*s = (uint32_t)(t / 1000);
	*ms = (uint32_t)(t % 1000);
}
#endif

int32_t Disp0_DrawBitmap(int16_t x, int16_t y, int16_t width, int16_t height, const uint8_t *bitmap)
{
	uint32_t err;
	LCD_BitmapType bp;

	bp.x = (uint16_t)x;
	bp.y = (uint16_t)y;
	bp.length = (uint16_t)width;
	bp.width = (uint16_t)height;
	bp.bitmap = bitmap;
	err = LCD_DrawBitmap(&s_lcd_tfp410, 2, &bp);

	return err == FSP_SUCCESS ? 0 : -1;
}

static uint32_t tfp410IicRead(uint8_t *data_w, uint8_t len_w, uint8_t *data_r, uint8_t len_r)
{
	return IIC_WriteRead(0x38, data_w, len_w, data_r, len_r);
}

static uint32_t tfp410IicWrite(uint8_t *data, uint8_t len)
{
	return IIC_Write(0x38, data, len);
}

static void updateCameraToLCD(void)
{
	uint32_t err;

	if (CameraIsCaptureDone(&s_camera_ov5640_mipi) == 0) {
		return;
	}
	if (s_camera_ov5640_mipi.image_ready == NULL) {
		return;
	}
	err = LCD_UpdateLayer1Mem(&s_lcd_tfp410, 2, s_camera_ov5640_mipi.image_ready, true, false);
	if (err) {
		return;
	}
	LCD_Present(&s_lcd_tfp410, 1);
}
