#include <stdio.h>

#include "console.h"
#include "hal_data.h"

#include "lcd/lcd.h"
#include "perf_counter/perf_counter.h"
#include "SEGGER_RTT/SEGGER_RTT.h"
#include "utils/log.h"

#define SEGGER_UP_BUFFER_1_SIZE		8192

#if (1 == BSP_MULTICORE_PROJECT) && BSP_TZ_SECURE_BUILD
bsp_ipc_semaphore_handle_t g_core_start_semaphore =
{
    .semaphore_num = 0
};
#endif

static volatile bool s_key_press;
static uint8_t s_cpu1_up_buffer[SEGGER_UP_BUFFER_1_SIZE] __attribute__((section(".segger_share")));

/*******************************************************************************************************************//**
 * main() is generated by the RA Configuration editor and is used to generate threads if an RTOS is used.  This function
 * is called by main() when no RTOS is used.
 **********************************************************************************************************************/
void hal_entry(void)
{
	/* TODO: add your own code here */
	uint32_t key_cnt = 0;

	perfc_init(false);
	SEGGER_RTT_Init();
	SEGGER_RTT_ConfigUpBuffer(1, "CPU1", s_cpu1_up_buffer, SEGGER_UP_BUFFER_1_SIZE, SEGGER_RTT_MODE_NO_BLOCK_SKIP);
	LOG_Reset();

	R_IPC_Open(g_ipc0.p_ctrl, g_ipc0.p_cfg);
	R_IPC_Open(g_ipc1.p_ctrl, g_ipc1.p_cfg);

	/* Wake up 2nd core if this is first core and we are inside a multicore project. */
#if (0 == _RA_CORE) && (1 == BSP_MULTICORE_PROJECT) && !BSP_TZ_NONSECURE_BUILD

#if BSP_TZ_SECURE_BUILD
    /* Take semaphore so 2nd core can clear it */
    R_BSP_IpcSemaphoreTake(&g_core_start_semaphore);
#endif

    R_BSP_SecondaryCoreStart();

#if BSP_TZ_SECURE_BUILD
    /* Wait for 2nd core to start and clear semaphore */
    while(FSP_ERR_IN_USE == R_BSP_IpcSemaphoreTake(&g_core_start_semaphore))
    {
        ;
    }
#endif
#endif

#if (1 == _RA_CORE) && (1 == BSP_MULTICORE_PROJECT) && BSP_TZ_SECURE_BUILD
    /* Signal to 1st core that 2nd core has started */
    R_BSP_IpcSemaphoreGive(&g_core_start_semaphore);
#endif

    CONSOLE_Init();
    R_ICU_ExternalIrqOpen(g_external_irq29.p_ctrl, g_external_irq29.p_cfg);
    R_ICU_ExternalIrqEnable(g_external_irq29.p_ctrl);

    while (1) {
    	if (s_key_press) {
    		s_key_press = false;
    		printf("Press cnt: %u\r\n", key_cnt);
    		key_cnt++;
    	}
    }

#if BSP_TZ_SECURE_BUILD
    /* Enter non-secure code */
    R_BSP_NonSecureEnter();
#endif
}

void EXTERNAL_IRQ_Callback(external_irq_callback_args_t *p_args)
{
	if (p_args->channel == 29) {
		s_key_press = true;
	}
}

void IPC0_Callback(ipc_callback_args_t *p_args)
{
	if (p_args->event & IPC_EVENT_IRQ0) {
		CONSOLE_IPCIrqHandle();
	}
	if (p_args->event & IPC_EVENT_MESSAGE_RECEIVED) {
		CONSOLE_IPCMsgHandle(p_args->message);
	}
}

#if BSP_TZ_SECURE_BUILD

FSP_CPP_HEADER
BSP_CMSE_NONSECURE_ENTRY void template_nonsecure_callable ();

/* Trustzone Secure Projects require at least one nonsecure callable function in order to build (Remove this if it is not required to build). */
BSP_CMSE_NONSECURE_ENTRY void template_nonsecure_callable ()
{

}
FSP_CPP_FOOTER

#endif

#if LOG_CFG_EN_TIMESTAMP
void LOG_GetTime(uint32_t *s, uint32_t *ms)
{
	int64_t t = get_system_ms();
	*s = (uint32_t)(t / 1000);
	*ms = (uint32_t)(t % 1000);
}
#endif
