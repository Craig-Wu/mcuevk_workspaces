#include "console.h"
#include "hal_data.h"
#include "iic.h"
#include "sdram.h"

#include "camera/camera.h"
#include "lcd/lcd.h"
#include "perf_counter/perf_counter.h"
#include "SEGGER_RTT/SEGGER_RTT.h"
#include "test/test.h"
#include "utils/log.h"

#define TFP410_IIC_ADDRESS			0x38
#define DVP_HSIZE                   640
#define DVP_VSIZE                   720
#define DVP_SIZE                    (DVP_HSIZE * DVP_VSIZE * 2)

#define HANDLE_ERROR(e, msg, ...)	if (e != FSP_SUCCESS) { \
										if (msg != NULL) { \
											LOG_E(__FUNCTION__, msg, ##__VA_ARGS__); \
										} \
										__disable_irq(); \
										while (1) { \
											R_IOPORT_PinWrite(g_ioport.p_ctrl, USER_LED, BSP_IO_LEVEL_LOW); \
											R_BSP_SoftwareDelay(100, BSP_DELAY_UNITS_MICROSECONDS); \
											R_IOPORT_PinWrite(g_ioport.p_ctrl, USER_LED, BSP_IO_LEVEL_HIGH); \
											R_BSP_SoftwareDelay(100, BSP_DELAY_UNITS_MICROSECONDS); \
										} \
									}

extern const vin_extended_cfg_t g_vin_ov5640_cfg_extend;

#if (1 == BSP_MULTICORE_PROJECT) && BSP_TZ_SECURE_BUILD
bsp_ipc_semaphore_handle_t g_core_start_semaphore =
{
    .semaphore_num = 0
};
#endif

static bool s_flag_5s;
static Camera s_camera_ov5640_dvp;
static Camera s_camera_ov5640_mipi;
static LCD_DeviceType s_lcd_tfp410;
static LCD_ConfigType s_tfp410_cfg;
static uint8_t s_dvp_image_1[DVP_SIZE] __attribute__((aligned(8))) __attribute__((section(".sdram_noinit_nocache")));
static uint8_t s_dvp_image_2[DVP_SIZE] __attribute__((aligned(8))) __attribute__((section(".sdram_noinit_nocache")));
static uint8_t s_dvp_image_3[DVP_SIZE] __attribute__((aligned(8))) __attribute__((section(".sdram_noinit_nocache")));

static uint32_t tfp410IicRead(uint8_t *data_w, uint8_t len_w, uint8_t *data_r, uint8_t len_r);
static uint32_t tfp410IicWrite(uint8_t *data, uint8_t len);

/*******************************************************************************************************************//**
 * main() is generated by the RA Configuration editor and is used to generate threads if an RTOS is used.  This function
 * is called by main() when no RTOS is used.
 **********************************************************************************************************************/
void hal_entry(void)
{
	/* TODO: add your own code here */
	uint32_t err;
	uint32_t gr1_underflow_cnt;
	uint32_t gr2_underflow_cnt;
	CameraConfig ov5640_config_dvp;
	CameraConfig ov5640_config_mipi;

	perfc_init(false);
#if CONSOLE_CFG_USE_RTT == 0
	SEGGER_RTT_Init();
#endif
	CONSOLE_Init();

	/* Clean screen */
#if CONSOLE_CFG_USE_RTT
	puts(RTT_CTRL_RESET);
	puts(RTT_CTRL_CLEAR);
#else
	puts("\x1b[2J\x1b[H");
	puts("\x1B[0m");
#endif
	printf("FSP Version: %s\r\n", FSP_VERSION_STRING);

	IIC_Init();
	R_GPT_Open(g_timer10.p_ctrl, g_timer10.p_cfg);
    R_GPT_Start(g_timer10.p_ctrl);
    R_GPT_Open(g_timer0.p_ctrl, g_timer0.p_cfg);

	s_tfp410_cfg.model = LCD_MODEL_TFP410PAPR;
    s_tfp410_cfg.peri_1 = &g_lcdc_tfp410;
    s_tfp410_cfg.peri_model_1 = LCD_PERI_GLCDC;
    s_tfp410_cfg.peri_2 = NULL;
    s_tfp410_cfg.peri_model_2 = LCD_PERI_UNUSED;
    s_tfp410_cfg.iicWrite = tfp410IicWrite;
    s_tfp410_cfg.iicRead = tfp410IicRead;
    err = LCD_Initialize(&s_lcd_tfp410, &s_tfp410_cfg);
    HANDLE_ERROR(err, "LCD_Initialize() failed: %u", err);

    ov5640_config_dvp.model = CAMERA_MODEL_OV5640;
    ov5640_config_dvp.interface = CAMERA_INTERFACE_DVP;
    ov5640_config_dvp.length = g_ceu_ov5640_cfg.x_capture_pixels;
    ov5640_config_dvp.width = g_ceu_ov5640_cfg.y_capture_pixels;
    ov5640_config_dvp.peripheral_inst = &g_ceu_ov5640;
    ov5640_config_dvp.buffer_1 = s_dvp_image_1;
    ov5640_config_dvp.buffer_2 = s_dvp_image_2;
    ov5640_config_dvp.buffer_3 = s_dvp_image_3;
    err = CameraInit(&s_camera_ov5640_dvp, &ov5640_config_dvp);
    HANDLE_ERROR(err, "OV5640 DVP interface init failed: %u", err);
    err = CameraSetFPS(&s_camera_ov5640_dvp, 30, NULL, false);
    HANDLE_ERROR(err, "OV5640 DVP interface set FPS failed: %u", err);
    R_BSP_SoftwareDelay(20, BSP_DELAY_UNITS_MILLISECONDS);
    CameraPowerDown(&s_camera_ov5640_dvp, 1);

    ov5640_config_mipi.model = CAMERA_MODEL_OV5640;
    ov5640_config_mipi.interface = CAMERA_INTERFACE_MIPI_CSI;
    ov5640_config_mipi.length = g_vin_ov5640_cfg_extend.conversion_data.uds_clipping_bits.cl_hsize;
    ov5640_config_mipi.width = g_vin_ov5640_cfg_extend.conversion_data.uds_clipping_bits.cl_vsize;
    ov5640_config_mipi.peripheral_inst = &g_vin_ov5640;
    err = CameraInit(&s_camera_ov5640_mipi, &ov5640_config_mipi);
    HANDLE_ERROR(err, "OV5640 MIPI interface init failed: %u", err);
    err = CameraSetFPS(&s_camera_ov5640_mipi, 30, NULL, false);
    HANDLE_ERROR(err, "OV5640 MIPI interface set FPS failed: %u", err);
    R_BSP_SoftwareDelay(20, BSP_DELAY_UNITS_MILLISECONDS);

    CameraPowerDown(&s_camera_ov5640_dvp, 0);
    err = CameraStartCapture(&s_camera_ov5640_dvp, NULL);
    HANDLE_ERROR(err, "OV5640 DVP interface start capture failed: %u", err);
    err = CameraStartCapture(&s_camera_ov5640_mipi, NULL);
    HANDLE_ERROR(err, "OV5640 MIPI interface start capture failed: %u", err);

	/* Wake up 2nd core if this is first core and we are inside a multicore project. */
#if (0 == _RA_CORE) && (1 == BSP_MULTICORE_PROJECT) && !BSP_TZ_NONSECURE_BUILD

#if BSP_TZ_SECURE_BUILD
    /* Take semaphore so 2nd core can clear it */
    R_BSP_IpcSemaphoreTake(&g_core_start_semaphore);
#endif

    R_BSP_SecondaryCoreStart();

#if BSP_TZ_SECURE_BUILD
    /* Wait for 2nd core to start and clear semaphore */
    while(FSP_ERR_IN_USE == R_BSP_IpcSemaphoreTake(&g_core_start_semaphore))
    {
        ;
    }
#endif
#endif

#if (1 == _RA_CORE) && (1 == BSP_MULTICORE_PROJECT) && BSP_TZ_SECURE_BUILD
    /* Signal to 1st core that 2nd core has started */
    R_BSP_IpcSemaphoreGive(&g_core_start_semaphore);
#endif

    gr1_underflow_cnt = s_lcd_tfp410.gr1_underflow_cnt;
    gr2_underflow_cnt = s_lcd_tfp410.gr2_underflow_cnt;
    R_GPT_Start(g_timer0.p_ctrl);
    while (1) {
        if (CameraIsCaptureDone(&s_camera_ov5640_mipi)) {
            if (s_camera_ov5640_mipi.image_ready == NULL) {
                continue;
            }
            err = LCD_UpdateLayer1Mem(&s_lcd_tfp410, 1, s_camera_ov5640_mipi.image_ready, true, false);
            if (err) {
                continue;
            }
            err = LCD_Present(&s_lcd_tfp410, 1);
            if (err) {
                LOG_E(__FUNCTION__, "Layer 1 present failed: %u", err);
            }
        }
        if (CameraIsCaptureDone(&s_camera_ov5640_dvp)) {
            if (s_camera_ov5640_dvp.image_ready == NULL) {
                continue;
            }
            err = LCD_UpdateLayer2Mem(&s_lcd_tfp410, 2, s_camera_ov5640_dvp.image_ready, true, false);
            if (err) {
                continue;
            }
            err = LCD_Present(&s_lcd_tfp410, 2);
            if (err) {
                LOG_E(__FUNCTION__, "Layer 2 present failed: %u", err);
            }
        }
        if (s_flag_5s) {
        	s_flag_5s = false;
        	printf("============ LCD Status Report ============\r\n");
        	printf("Layer 1 new underflow cnt: %u\r\n", s_lcd_tfp410.gr1_underflow_cnt - gr1_underflow_cnt);
        	printf("Layer 2 new underflow cnt: %u\r\n", s_lcd_tfp410.gr2_underflow_cnt - gr2_underflow_cnt);
        	gr1_underflow_cnt = s_lcd_tfp410.gr1_underflow_cnt;
        	gr2_underflow_cnt = s_lcd_tfp410.gr2_underflow_cnt;
        }
    }

#if BSP_TZ_SECURE_BUILD
    /* Enter non-secure code */
    R_BSP_NonSecureEnter();
#endif
}

#if BSP_TZ_SECURE_BUILD

FSP_CPP_HEADER
BSP_CMSE_NONSECURE_ENTRY void template_nonsecure_callable ();

/* Trustzone Secure Projects require at least one nonsecure callable function in order to build (Remove this if it is not required to build). */
BSP_CMSE_NONSECURE_ENTRY void template_nonsecure_callable ()
{

}
FSP_CPP_FOOTER

#endif

#if LOG_CFG_EN_TIMESTAMP
void LOG_GetTime(uint32_t *s, uint32_t *ms)
{
	int64_t t = get_system_ms();
	*s = (uint32_t)(t / 1000);
	*ms = (uint32_t)(t % 1000);
}
#endif

void CEU_OV5640_Callback(capture_callback_args_t *p_args)
{
	(void)p_args;
}

void GLCDC_Callback(display_callback_args_t *p_args)
{
	(void)p_args;
}

void MIPI_CSI_Callback(mipi_csi_callback_args_t *p_args)
{
	(void)p_args;
}

void TIMER0_Callback(timer_callback_args_t *p_args)
{
	static uint32_t cnt;

    bsp_io_level_t level;

    (void)p_args;

    R_IOPORT_PinRead(g_ioport.p_ctrl, USER_LED, &level);
    if (level == BSP_IO_LEVEL_HIGH) {
        R_IOPORT_PinWrite(g_ioport.p_ctrl, USER_LED, BSP_IO_LEVEL_LOW);
    }
    else {
        R_IOPORT_PinWrite(g_ioport.p_ctrl, USER_LED, BSP_IO_LEVEL_HIGH);
    }

	cnt++;
	if ((cnt % 10) == 0) {
		s_flag_5s = true;
	}
}

void VIN_Callback(capture_callback_args_t *p_args)
{
	(void)p_args;
}

static uint32_t tfp410IicRead(uint8_t *data_w, uint8_t len_w, uint8_t *data_r, uint8_t len_r)
{
	return IIC_WriteRead(TFP410_IIC_ADDRESS, data_w, len_w, data_r, len_r);
}

static uint32_t tfp410IicWrite(uint8_t *data, uint8_t len)
{
	return IIC_Write(TFP410_IIC_ADDRESS, data, len);
}
